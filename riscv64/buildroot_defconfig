## riscv64/buildroot_defconfig
```kconfig
########################
# toolchain 
########################
BR2_riscv=y
BR2_RISCV_64=y
BR2_TOOLCHAIN_BUILDROOT_CXX=y
BR2_TOOLCHAIN_BUILDROOT_GLIBC=y
BR2_PACKAGE_GLIBC_UTILS=y

########################
# rootfs 
########################
# BR2_ROOTFS_OVERLAY="$(CONFIG_DIR)/test-overlay"
BR2_TARGET_ROOTFS_CPIO=y
# BR2_TARGET_ROOTFS_TAR=n
BR2_TARGET_ROOTFS_INITRAMFS=n
# BR2_TARGET_ROOTFS_EXT2=n
# BR2_TARGET_ROOTFS_EXT2_4=y
# BR2_TARGET_ROOTFS_EXT2_SIZE="80M"

########################
# kernel 
########################
BR2_LINUX_KERNEL=y
BR2_LINUX_KERNEL_IMAGE=y
BR2_LINUX_KERNEL_USE_CUSTOM_CONFIG=y
BR2_LINUX_KERNEL_CUSTOM_CONFIG_FILE="output/build/linux-custom/arch/riscv/configs/defconfig"

########################
# packages 
########################
BR2_PACKAGE_OVERRIDE_FILE="$(CONFIG_DIR)/local.mk"

## Environment 
BR2_PACKAGE_BUSYBOX_SHOW_OTHERS=y
BR2_PACKAGE_BASH=y
BR2_SYSTEM_BIN_SH_BASH=y
# BR2_PACKAGE_TMUX=y
BR2_ENABLE_LOCALE_WHITELIST="C en_US en_US.UTF-8"
BR2_GENERATE_LOCALE="en_US.UTF-8"

## Utilities
# BR2_PACKAGE_ELFUTILS=y
# BR2_PACKAGE_ELFUTILS_PROGS=y
# BR2_PACKAGE_PERL=y
# BR2_PACKAGE_BINUTILS=y
# BR2_PACKAGE_BINUTILS_TARGET=y
BR2_PACKAGE_UTIL_LINUX=y
BR2_PACKAGE_UTIL_LINUX_BINARIES=y
BR2_PACKAGE_UTIL_LINUX_SCHEDUTILS=y
BR2_PACKAGE_COREUTILS=y

## Debugging
# BR2_PACKAGE_GDB=y
# BR2_PACKAGE_GDB_DEBUGGER=y
# BR2_PACKAGE_GDB_SERVER=y
# BR2_TOOLCHAIN_EXTERNAL_GDB_SERVER_COPY=y
# BR2_PACKAGE_DTC=y
# BR2_PACKAGE_DTC_PROGRAMS=y
# BR2_PACKAGE_STRACE=y

## Networking
# BR2_PACKAGE_OPENSSH=y
# BR2_PACKAGE_CA_CERTIFICATES=y
# BR2_PACKAGE_WGET=y
# BR2_PACKAGE_IPROUTE2=y
# BR2_PACKAGE_IPTABLES=y
# BR2_PACKAGE_BRIDGE_UTILS=y
# BR2_PACKAGE_DNSMASQ=y
# BR2_PACKAGE_NETCAT=y
# BR2_PACKAGE_EBTABLES=y

########################
# optimization
########################
BR2_STRIP_strip=y
# BR2_PACKAGE_IFUPDOWN=n
# BR2_PACKAGE_IFUPDOWN_SCRIPTS=n
# BR2_PACKAGE_URANDOM_SCRIPTS=n
# BR2_PACKAGE_BUSYBOX_CONFIG="package/busybox/busybox-minimal.config"
```
